## drivers/misc/node-i2c/Kconfig
```kconfig
menuconfig NODE_I2C
	tristate "GenWQE PCIe Accelerator"
	default n
	help
		sample for i2c
```

## drivers/misc/node-platform/Kconfig
```kconfig
menuconfig NODE_PLATFORM
	tristate "GenWQE PCIe Accelerator"
	default n
	help
		sample for platform
```
